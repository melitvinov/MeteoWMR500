/***********************************************************************************
* Наименование модуля	: Управление системными светодиодами
*-----------------------------------------------------------------------------------
* Версия				: 1.0
* Автор					: Тимофеев
* Дата создания			: 23.05.2018
************************************************************************************/

//--- INCLUDES -------------------
#include "leds.h"

//--- CONSTANTS ------------------
const TLedDesc Led[] = {
	{PORT_LED_R, OUT_LED_R},
	{PORT_LED_G, OUT_LED_G},
	{PORT_LED_B, OUT_LED_B},
};

//--- GLOBAL VARIABLES -----------

//--- FUNCTIONS ------------------

/*******************************************************
Функция		: Инициализация железа
Параметр 1	: нет
Возвр. знач.: нет
********************************************************/
void Leds_init(void)
{
	for( int i=0; i<LED_COUNT; i++ )
	{
		// Перевод вывода светодиода на выход с открытым коллектором
		GPIO_PinConfigure( Led[i].GPIOx, Led[i].num, GPIO_OUT_PUSH_PULL, GPIO_MODE_OUT2MHZ );
		// Отключение светодиода (отключаются лог. 1)
		GPIO_PinWrite( Led[i].GPIOx, Led[i].num, 1 );
	}
}

/*******************************************************
Функция		: включение светодиода
Параметр 1	: номер светодиода
Возвр. знач.: нет
********************************************************/
void Led_On(uint8_t led_num)
{
	if(( led_num < LED_RED ) || ( led_num > LED_BLUE ))
		return;
	
	// включаются лог. нулем
	GPIO_PinWrite( Led[led_num-1].GPIOx, Led[led_num-1].num, 0 );
}

/*******************************************************
Функция		: отключение светодиода
Параметр 1	: номер светодиода
Возвр. знач.: нет
********************************************************/
void Led_Off(uint8_t led_num)
{
	if(( led_num < LED_RED ) || ( led_num > LED_BLUE ))
		return;
	
	GPIO_PinWrite( Led[led_num-1].GPIOx, Led[led_num-1].num, 1 );
}

/*******************************************************
Функция		: Возвращает состояние светодиода
Параметр 1	: номер светодиода
Возвр. знач.: состояние светодиода
********************************************************/
bool Led_IsOn(uint8_t led_num)
{
    bool isHigh;
	
	if(( led_num < LED_RED ) || ( led_num > LED_GREEN ))
		return false;
	
    isHigh = (bool) GPIO_PinRead(Led[led_num-1].GPIOx, Led[led_num-1].num);

    return !isHigh;
}

/*******************************************************
Функция		: переключение светодиода
Параметр 1	: номер светодиода
Возвр. знач.: нет
********************************************************/
void Led_Switch(uint8_t led_num)
{
    if( Led_IsOn(led_num) ) 
        Led_Off(led_num);
    else
        Led_On(led_num);
}

/*******************************************************
Функция		: включение всех светодиодов
Параметр 1	: нет
Возвр. знач.: нет
********************************************************/
void Leds_OnAll(void)
{
	for( int num = 1; num <= LED_COUNT; num++ ) 
	{
		Led_On( num );
	}
}

/*******************************************************
Функция		: отключение всех светодиодов
Параметр 1	: нет
Возвр. знач.: нет
********************************************************/
void Leds_OffAll(void)
{
	for( int num = 1; num <= LED_COUNT; num++ ) 
	{
		Led_Off( num );
	}
}
